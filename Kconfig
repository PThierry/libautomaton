## Kconfig
```kconfig
config USR_LIB_AUTOMATON
  bool  "userspace generic state automaton"
  default y
  ---help---
  Support for generic, secure and reentrent state automaton

if USR_LIB_AUTOMATON

menu "Automaton options"

config USR_LIB_AUTOMATON_DEBUG
  int "Automaton debug informations level"
  default 0
  range 0 1
  ---help---
  Automaton debug level. Supported levels are:
    * 0: no debug
    * 1: state change information debug

config USR_LIB_AUTOMATON_MAX_CONTEXT_NUM
   int "Max number of contexts handled by libautomaton"
   default 4
   range 1 32
   ---help---
   Specify the number of automaton contexts the libautomaton can handle in the same time.

config USR_LIB_AUTOMATON_DATA_INTEGRITY_CHECK
   bool "Enable data integrity check in automaton contexts"
   select USR_LIB_FIRMWARE
   default n
   ---help---
   Add integrity check on automaton context access, to detect memory corruption due to
   software overflow or various hardware or software memory corruption techniques.

config USR_LIB_AUTOMATON_CONTROL_FLOW_INTEGRITY
   bool "Enable automaton control flow integrity"
   default n
   ---help---
   Add advanced mechanism to verify that the overall automaton sequence is respectfull of
   the formal automaton definition. This mechanisms detects fault attack that may generate
   execution of currently unreachable states or transitions.
   This mechanism *does not* protect against checkpoint passing jump (i.e. transition to
   a reachable, formally valid, state withtout executing a previously required state.


config USR_LIB_AUTOMATON_HANDLE_CHECKPOINTS
   bool "Enable data integrity check in automaton contexts"
   default n
   ---help---
   Add checkpoints validation for critical states. This is a complementary mechanism to the
   CFI. For each critical state (defined by the application), a list of checkpoint states
   is defined and the automaton verifies that all of them have been previously reached at
   least one time before entering the critical state.


config USR_LIB_AUTOMATON_MAX_TRANSITION_PER_STATE
   int "Set maximum number of transition per states"
   range 2 16
   ---help---
   This defines the number of cells of the automaton_transition_t structure the
   application must declare to the libautomaton.

endmenu

endif
```
